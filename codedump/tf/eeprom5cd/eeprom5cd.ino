 #include <Wire.h> //I2C library

  byte somedata[]= { 0x0, 0xaa, 0x55, 0x0, 0x0, 0x0, 0x0, 0x0, 0x0, 0x0, 0x0, 0x0, 0x0, 0x0, 0x0, 0x0, 


   0x32, 0x17, 0x2, 0x1, 0x2, 0x1, 0xa, 0x0, 0x1a, 0x0, 0x1a, 0x1a, 0x1a, 0x1a, 0x1a, 0x1a, //300
   0x20, 0x5, 0x6, 0x10, 0x1, 0xff, 0x01, 0x02, 0x77, 0x77, 0x77, 0x77, 0x77, 0x77, 0x77, 0x77, //310
   0x77, 0x77, 0x77, 0x77, 0x77, 0x5, 0x4, 0x6, 0x77, 0x077, 0x55, 0xff, 0x77, 0x77, 0x77, 0x77, //320
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   0xe, 0xd, 0x13, 0x7, 0xa, 0xff, 0xff, 0xff, 0xff, 0xff, 0x0, 0x0, 0x0, 0x0, 0x0, 0x0,
   0x2f, 0x2e, 0x31, 0x1f, 0x21, 0xff, 0xff, 0xff, 0xff, 0x3b, 0x0, 0x0,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 0x0, 0x0 };
 

  void i2c_eeprom_write_byte( int deviceaddress, unsigned int eeaddress, byte data ) {
    int rdata = data;
    Wire.beginTransmission(deviceaddress);
    Wire.write((int)(eeaddress >> 8)); // MSB
    Wire.write((int)(eeaddress & 0xFF)); // LSB
    Wire.write(rdata);
    Wire.endTransmission();
  }

  // WARNING: address is a page address, 6-bit end will wrap around
  // also, data can be maximum of about 30 bytes, because the Wire library has a buffer of 32 bytes
  void i2c_eeprom_write_page( int deviceaddress, unsigned int eeaddresspage, byte* data, byte length ) {
    Wire.beginTransmission(deviceaddress);
    Wire.write((int)(eeaddresspage >> 8)); // MSB
    Wire.write((int)(eeaddresspage & 0xFF)); // LSB
    byte c;
    for ( c = 0; c < length; c++)
      Wire.write(data[c]);
    Wire.endTransmission();
  }

  byte i2c_eeprom_read_byte( int deviceaddress, unsigned int eeaddress ) {
    byte rdata = 0xFF;
    Wire.beginTransmission(deviceaddress);
    Wire.write((int)(eeaddress >> 8)); // MSB
    Wire.write((int)(eeaddress & 0xFF)); // LSB
    Wire.endTransmission();
    Wire.requestFrom(deviceaddress,1);
    if (Wire.available()) rdata = Wire.read();
    return rdata;
  }

  // maybe let's not read more than 30 or 32 bytes at a time!
  void i2c_eeprom_read_buffer( int deviceaddress, unsigned int eeaddress, byte *buffer, int length ) {
    Wire.beginTransmission(deviceaddress);
    Wire.write((int)(eeaddress >> 8)); // MSB
    Wire.write((int)(eeaddress & 0xFF)); // LSB
    Wire.endTransmission();
    Wire.requestFrom(deviceaddress,length);
    int c = 0;
    for ( c = 0; c < length; c++ )
      if (Wire.available()) buffer[c] = Wire.read();
  }




  void setup() 
  {
  
    int i;
    Wire.begin(); // initialise the connection

        delay(5000);
    for(i = 0; i <  200; i++){
      Serial.print(i);
      i2c_eeprom_write_byte(0x50, i, somedata[i]);
      
        delay(10);
    }
             Serial.begin(9600);
        Serial.print(sizeof(somedata));
                delay(5000);
       // i2c_eeprom_write_byte(0x50, 0x20, 0xaa );
   //i2c_eeprom_write_page(0x50, 0, (byte *)somedata, sizeof(somedata)); // write to EEPROM 

   //add a small delay

     Serial.println("Hello, Natalie");
    Serial.println("Memory written");
  }

  void loop() 
  {
    Serial.begin(9600);
     Wire.begin();
   int addr=0; //first address
    int i;
    byte b = i2c_eeprom_read_byte(0x50, 0); // access the first address from the memory

    for (i = 0; i < 4000; i++) 
    {
      Serial.print(b, HEX); //print content to serial port
      Serial.print(" ");
      addr++; //increase address
      b = i2c_eeprom_read_byte(0x50, addr); //access an address from the memory
    }
    Serial.println(" ");
    delay(2000);

  while(true){}  }
  
  
  
  
  
  
