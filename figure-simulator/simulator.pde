#include <DSPI.h>

DSPI0 spi;
const int len = 200;
uint8_t    rgbSnd[len] = {0};
uint8_t    rgbRcv[len] = {0};
uint8_t b[] ={0x40, 0x00, 0x00, 0xC4, 0x00, 0x00, 0xDC, 0x00, 0x00, 0x0F, 0x01, 0x00, 0x91,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 0xD4, 0x2C};
int i;
int yc = 0;
int x=0;
int y=0;

void setup()
{
  Serial.begin(9600);
  Serial.println("start");
  spi.begin();
  spi.setSpeed(600000);
  SPI2CONbits.ON = 0;
  rgbRcv[0] = SPI2BUF;
  SPI2CONbits.MSTEN = 0;
  SPI2CONbits.SSEN = 1;
  SPI2CONbits.CKP = 0;  
  SPI2CONbits.CKE = 1;
  rgbSnd[4] = 0xaa;
  rgbSnd[5] = 0x55; 
  rgbSnd[6] = 0x08; 

  rgbSnd[11] = 0xaa;
  rgbSnd[12] = 0x55; 
  
  
  
  rgbSnd[17] = 0x03; 
  rgbSnd[18] = 0x03;
  rgbSnd[19] = 0x03;
  rgbSnd[20] = 0x00;
    rgbSnd[21] = 0x00;
      rgbSnd[22] = 0x10;
        rgbSnd[23] = 0x03;
       //     rgbSnd[28] = 0x40;
        //     rgbSnd[31] = 0xc4;
         //    rgbSnd[34] = 0xdc;
             
      //       rgbSnd[40] =  
     while(i<96-28){
       for(y = 0; y < 8; y++){
         rgbSnd[28 + i] = b[yc++];
         i++;
       }
       for(x = 0; x < 4; x++){
         i++;
       }
     } 
     
  rgbSnd[100] = 0xaa;
  rgbSnd[101] = 0x55; 
  rgbSnd[106] = 0x9a; 
   rgbSnd[107] = 0x2b; 
     rgbSnd[108] = 0x00; 
    rgbSnd[113] = 0x11;  
     rgbSnd[114] = 0x15; 
       rgbSnd[119] = 0xaa;
  rgbSnd[120] = 0x55; 
    ///     rgbSnd[140] = 0xff;
  SPI2CONbits.ON = 1;
  Serial.println("start 2");
}

void loop()
{
   for (i = 0; i < 150; i++)
   {
     rgbRcv[i] = spiComm(rgbSnd[i]);
   }
   

  for(i = 0; i < 150; i++)
   {
     Serial.print(i);
     Serial.print(" ");
     Serial.print(rgbSnd[i], HEX);
     Serial.print(" ");
     Serial.println(rgbRcv[i], HEX);
   }
        Serial.println("END");
}

uint8_t spiComm(uint8_t bVal)
{
  while ((SPI2STAT & (1 << _SPISTAT_SPITBE)) == 0) {
  }
  SPI2BUF = bVal;

  while ((SPI2STAT & (1 << _SPISTAT_SPIRBF)) == 0) {
  }

  return SPI2BUF;
}
